// Network workers publish immutable results; only loopTask owns UI/history.
struct InboxHttpPayload { String url, token, eventId, body; bool otaManifest = false, applyAfter = false, announce = false, logsUpload = false; };
struct InboxHttpResult { int code=0; String body, eventId; bool otaManifest = false, applyAfter = false, announce = false, logsUpload = false; };
constexpr uint32_t kOtaAutoCheckIntervalMs = 20000U;
constexpr uint32_t kOtaScreenCheckIntervalMs = 5000U;
uint32_t gOtaLastAutoCheckMs = 0;
portMUX_TYPE gInboxHttpMux = portMUX_INITIALIZER_UNLOCKED;
InboxHttpResult* gInboxHttpResult = nullptr;
bool gInboxHttpBusy = false;
bool gPendingLogsUpload = false, gLogsUploadBusy = false;
bool autoInboxPollAllowed();
bool startInboxNetworkRequest(std::unique_ptr<InboxHttpPayload> payload);
void servicePendingLogsUpload();
volatile bool gInboxCancelRequested = false;
bool gG0VoicePending = false;
bool gVoiceCapturePreparing = false;
uint32_t gG0VoiceRequestedMs = 0;
bool gUiInputPending = false;
uint32_t gUiInputAtMs = 0, gUiInputMaxMs = 0;
const char* gUiInputSource = "none";
uint32_t gUiMinHeap = UINT32_MAX, gUiMinLargest = UINT32_MAX, gUiMinStack = UINT32_MAX;
uint32_t gUiMaxServiceGapMs = 0, gUiLastServiceMs = 0, gUiLastMemorySampleMs = 0;
volatile bool gInboxAllocationFailed = false;
volatile bool gTextTurnAllocationFailed = false;
uint32_t gInboxRetryAfterMs = 0;
std::deque<String> gInboxAckQueue;
std::deque<uint32_t> gStoredAssistantSeqs;
void rememberStoredAssistantSeq(uint32_t seq);
bool consumeStoredAssistantSeq(uint32_t seq);
bool gPendingRealtimeStart = false;
bool gPendingRealtimeAutoStart = false;
struct RealtimeDialRequest { String host,request,key; uint16_t port=443; uint32_t generation=0; };
struct RealtimeDialResult {
  std::unique_ptr<WiFiClientSecure> socket;
  String key,error;
  uint32_t generation=0;
};
portMUX_TYPE gRealtimeDialMux=portMUX_INITIALIZER_UNLOCKED;
RealtimeDialResult* gRealtimeDialResult=nullptr;
bool gRealtimeDialBusy=false;
bool gRealtimeDialCanvasReleased=false;
volatile bool gRealtimeDialAllocationFailed=false;
uint32_t gRealtimeDialGeneration=0;
void serviceRealtimeDialCompletion();
bool beginRealtimeDial();
void cancelRecordingDiscard();
bool gChatCommandsVisible = false;
bool gVoiceNoticeVisible = false;
enum class VoiceRequestPhase : uint8_t { None, Recording, Sending, Processing, Accepted, Reply, Error };
VoiceRequestPhase gVoiceRequestPhase=VoiceRequestPhase::None;
String gVoiceRequestTranscript;
uint8_t gVoiceRequestProgress=0;
bool gVoiceNoticePending = false;
bool gInboxLastFromAssistant = false;
uint32_t gVoiceReplyNotifyUntilMs = 0;
String gVoiceNoticeText;
uint32_t gVoiceNoticeShownMs = 0;
String gQueuedVoiceReplySpeech;
bool gVoiceReplySpeechBusy = false;
volatile uint32_t gVoiceReplySpeechGeneration = 0;
void showVoiceNotice(const String& text, bool pending);
firmware_job_display::State gFirmwareJobState = firmware_job_display::State::Idle;
uint32_t gFirmwareJobLastSyncMs = 0;
uint32_t gBridgeLastSuccessMs = 0;
bool gBridgeHttpFailed = false;
String gFirmwareJobRequestId;
void applyFirmwareJobState(const String& state, const String& requestId);
const char* homeStatusLabel(bool updateReady);
bool handleHomeLinkRetryKey(char key, const Keyboard_Class::KeysState& keys);
void openAssistantConversation();
bool handleUnreadAssistantKey(char key, const Keyboard_Class::KeysState& keys);
void acceptPendingAssistantRequest(const String& transcript, const String& acknowledgement,
                                   uint32_t afterSeq, uint32_t receiptSeq);
void beginVoiceRequestUi();
void showVoiceRequestError(const String& text);
void dismissVoiceNotice();
bool handleVoiceRequestEscape();
bool handleVoiceNoticeKey(char key, const Keyboard_Class::KeysState& keys);
bool voiceRequestBusyUi();
void renderVoiceNotice();
void serviceVoiceReplySpeech();
void initSpeaker();
bool gVoiceDialBusy = false;
bool gVoiceDialCanvasReleased = false;
bool gVoicePreconnectEarly = false;
struct VoiceCaptureUpload {
  capture_upload::State stream;
  std::mutex fileMutex;
  fs::FS* fs = nullptr;
  File* activeFile = nullptr;
  String path, turnId;
  bool registered = false;
};
std::shared_ptr<VoiceCaptureUpload> gVoiceCaptureUpload;
bool gVoiceReadyStreamed = false;
bool gVoiceReadyEarlyReply = false;
void beginVoiceCaptureUpload();
void finishVoiceCaptureUpload(size_t bytes);
void publishVoiceCaptureBytes();
// The active w+ WAV is the only spool. Its cursor is restored before capture
// resumes; the network worker never owns this lock during TLS/socket writes.
std::unique_lock<std::mutex> lockVoiceCaptureFile() {
  return gVoiceCaptureUpload ? std::unique_lock<std::mutex>(gVoiceCaptureUpload->fileMutex)
                            : std::unique_lock<std::mutex>();
}
reply_connection::OneShot<WiFiClient> gVoiceReplyConnection;
bool gInboxCanvasReleased = false;
bool gVoiceSpeechCanvasReleased = false;
void beginVoicePreconnect();
void cancelVoicePreconnect();
void serviceVoicePreconnect();
std::unique_ptr<WiFiClient> takeVoicePreconnect();
bool beginVoiceWifiPerformance();
void endVoiceWifiPerformance();
uint8_t gChatCommandSelection = 0;
void serviceInboxNetworkCompletion();
void servicePendingRealtimeStart();
bool isAssistantUi();
bool appAllowsBackgroundNetwork();
void toggleFocusGuidedAudio();
void adjustCurrentSetting(int delta);
void toggleCurrentSetting();
bool returnToSettingsHub();
bool handleSettingsNavigation(bool up,bool down,bool left,bool right);
bool handleAssistantMenuKey(char key,const Keyboard_Class::KeysState& keys);
bool handleEyeSkinKey(char key,const Keyboard_Class::KeysState& keys);
void renderRealtimeEyesUi();
bool playUpdateChime();
void renderRealtimeUi();
void renderRealtimeBadges();
void toggleRealtimeView();
const char* realtimeStageLabel();
void failRealtimeSession(const String& reason);
bool gRealtimeScreenVisible=false;
bool gRealtimeClassicView=false;
constexpr uint8_t kChatCommandCount=7;
String gRealtimeUiError;
String gRealtimeUiTranscript;
void runChatCommand(uint8_t index);
void renderChatCommandsOverlay();
bool enterNesApp();
void leaveNesApp();
void serviceNesApp();
void renderNesMenu();
bool handleNesHostCommand(const String& line);
void serviceNesTransfer();

FaceMode gFaceMode = FaceMode::Idle;
KeyboardLayout gKeyboardLayout = KeyboardLayout::En;
UiMode gUiMode = UiMode::Home;
UiMode gScreensaverPreviousMode = UiMode::Home;
Keyboard_Class::KeysState gKeyboardState;
int16_t* gRecordBuffer = nullptr;
int16_t* gTtsBuffer = nullptr;
size_t gRecordedSamples = 0;
size_t gRecordCapacitySamples = 0;
size_t gRecordCapacityBytes = 0;
size_t gTtsCapacitySamples = 0;
size_t gTtsCapacityBytes = 0;
float gEyeLookX = 0.0f;
float gEyeLookY = 0.0f;
float gEyePanelShiftX = 0.0f;
float gEyePanelShiftY = 0.0f;
uint8_t gSpeakerVolume = 255;
String gLastVoiceDiag = "boot";
String gLastHttpDiag = "boot";
String gLastKeyDiag = "-";
String gNoteInputBuffer;
String gActiveNotePath;
String gActiveNoteName;
String gNotesStatus = "Ready";
String gStorageLabel = "off";
String gLastKeySignature;
EmojiCacheEntry gEmojiCache[kEmojiCacheCap];
uint8_t gEmojiCacheSize = 0;
size_t gEmojiAssetCount = 0;
bool gCtrlSoloHeld = false;
bool gCtrlSoloCandidate = false;
bool gG0VoiceHeld = false;
bool gRecordingToFile = false;
bool gRecordFileWriteFailed = false;
bool gPlaybackStreaming = false;
uint8_t* gDynamicPlaybackBuffer = nullptr;
bool gTimeZoneConfigured = false;
bool gTimeValid = false;
bool gRealtimeActive = false;
bool gRealtimeConnected = false;
bool gRealtimeStartAfterReady = false;
bool gRealtimeRecording = false;
bool gRealtimeVadStopPending = false;
bool gRealtimeAwaiting = false;
bool gRealtimeGotAudio = false;
bool gRealtimeHandsFreeActive = false;
bool gRealtimeRestartAfterPlayback = false;
bool gRealtimeExclusiveMode = false;
bool gRealtimePlaybackActive = false;
bool gRealtimePlaybackFeeding = false;
bool gRealtimePlaybackEverStarted = false;
bool gRealtimeAudioComplete = false;
bool gRealtimeResponseComplete = false;
bool gRealtimeSmokeActive = false;
bool gRealtimeSmokeTextPending = false;
const char* gRealtimeSmokePrompt = "Say one short word: ready.";
bool gRealtimeSmokeAudioPending = false;
bool gRealtimeSmokeAudioStreaming = false;
bool gRealtimeAuthPending = false;
bool gRealtimeTlsVerify = true;
bool gRealtimeBinaryAudio = false;
bool gRealtimeBinaryModelSequenceSeen = false;
bool gRealtimeWifiSleepSaved = false;
bool gBlockingInputPumpActive = false;
bool gCanvasSpriteActive = false;
bool gScreensaverActive = false;
bool gScreensaverDimmed = false;
bool gScreenOffActive = false;
uint32_t gLastUserActivityMs = 0;
uint32_t gLastUserInputMs = 0;
uint32_t gScreensaverStartedMs = 0;
uint32_t gRealtimeSessionStartedMs = 0;
uint32_t gRealtimeAwaitingStartedMs = 0;
uint32_t gRealtimeSmokeAudioNextMs = 0;
uint32_t gRealtimeAuthDueMs = 0;
uint32_t gRealtimeNextListenMs = 0;
uint32_t gRealtimeLatencyOriginMs = 0;
uint32_t gRealtimeFirstAudioDeltaMs = 0;
uint32_t gRealtimeLastAudioDeltaMs = 0;
uint32_t gRealtimePlaybackStartMs = 0;
uint32_t gRealtimePlaybackProgressMs = 0;
uint32_t gRealtimeAudioDoneMs = 0;
uint32_t gRealtimeMicSequence = 0;
uint32_t gRealtimeExpectedModelSequence = 0;
uint32_t gRealtimeBinaryTxFailures = 0;
uint32_t gRealtimeBinaryRxSequenceErrors = 0;
uint32_t gBlockingPumpInputEvents = 0;
uint32_t gLastBlockingPumpInputMs = 0;
uint32_t gLastLoopSlowMs = 0;
uint32_t gLoopMaxMs = 0;
size_t gRealtimeSmokeAudioChunkIndex = 0;
String gSerialControlBuffer;
File gActiveRecordFile;
String gActiveRecordPath;
size_t gActiveRecordBytes = 0;
size_t gActiveRecordCommittedBytes = 0;
size_t gActiveRecordExpectedBytes = 0;
std::deque<uint8_t> gRecordInflightChunks;
uint8_t gRecordNextChunkIndex = 0;
int16_t gRecordChunkBuffers[kRecordChunkBufferCount][kRecordChunkSamples];
String gRealtimeSessionId;
String gRealtimeText;
size_t gRealtimeReplyBytes = 0;
size_t gRealtimePlaybackDroppedBytes = 0;
size_t gRealtimePlaybackRead = 0;
size_t gRealtimePlaybackWrite = 0;
size_t gRealtimePlaybackBufferedBytes = 0;
uint8_t gRealtimePlaybackNextBuffer = 0;
std::unique_ptr<uint8_t[]> gRealtimePlaybackBlocks[kRealtimePlaybackBlockCount];
uint32_t gRealtimeStartedMs = 0;
RealtimeChunkQueue gRealtimeInflightChunks;
uint8_t gRealtimeNextChunkIndex = 0;
int16_t gRealtimeInputBuffers[kRealtimeChunkBufferCount][kRealtimeInputChunkSamples];
uint8_t gRealtimeBinaryMicFrame[kRealtimeWsHeaderReserve +
                                kRealtimeBinaryHeaderBytes +
                                kRealtimeInputChunkBytes];
wifi_ps_type_t gRealtimePreviousWifiSleep = WIFI_PS_NONE;
File gPlaybackStreamFile;
String gPlaybackStreamPath;
fs::FS* gPlaybackStreamFs = nullptr;
uint32_t gPlaybackStreamSampleRate = 0;
size_t gPlaybackStreamRemainingBytes = 0;
size_t gPlaybackStreamTotalBytes = 0;
uint8_t gPlaybackStreamNextBuffer = 0;
bool gPlaybackStreamRawPcm = false;
uint8_t gPlaybackStreamBuffers[kPlaybackBufferCount][kPlaybackChunkBytes];
// OTA apply runs on Arduino's loopTask; keep the large flash scratch buffer
// out of that task stack or the device reboots before selecting the new slot.
uint8_t gOtaIoBuffer[kOtaIoBufferBytes];
uint32_t gPlaybackStartedMs = 0;
uint32_t gPlaybackDurationMs = 0;
uint32_t gPlaybackLastProgressMs = 0;
int16_t gVoiceTickerX = 90;
uint8_t gVoiceGraphSpeed = 0;
uint8_t gVoiceLevel8 = 28;
mic_input_meter::State gMicInputMeter;
uint32_t gAssistantPulsePressUntilMs = 0;
uint8_t gVoiceEqBars[kPlaybackSpectrumBands] = {};
uint8_t gVoiceEqPeaks[kPlaybackSpectrumBands] = {};
BatterySnapshot gBatterySnapshot;
BatteryHistorySample gBatteryHistory[kBatteryHistoryCapacity];
uint8_t gBatteryHistoryCount = 0;
uint8_t gBatteryHistoryHead = 0;
float gBatteryDrainPctPerHour = 0.0f;
int16_t gBatteryDrainMvPerHour = 0;
uint16_t gBatteryEtaMinutes = 0;
bool gBatteryDrainKnown = false;
FocusSettings gFocusSettings;
DeviceSettings gDeviceSettings;
AlarmSettings gAlarmSettings;
FocusRuntime gFocus;
PetRuntime gPet;
AssetManifestSummary gAssetManifest;
OtaManifestSummary gOtaManifest;
String gOtaNotifiedVersion;
int16_t gUpdateChime[release_delivery::kChimeSamples];
bool gVoiceReplyPending = false;
uint32_t gVoiceReplyAfterSeq = 0;
uint32_t gVoiceReplyPendingMs = 0;
bool gInboxUnread = false;
NotesMode gNotesMode = NotesMode::List;
bool gOtaPendingVerify = false;
bool gOtaConfirmedThisBoot = false;
bool gOtaApplyInProgress = false;
bool gOtaBootApplyMode = false;
uint32_t gOtaVerifyStartMs = 0;
uint32_t gOtaLastHealthProbeMs = 0;
String gOtaRunningSlot = "-";
String gOtaBootState = "unknown";
bool gTransferUiActive = false;
String gTransferTitle;
String gTransferDetail;
uint32_t gTransferDone = 0;
uint32_t gTransferTotal = 0;
uint32_t gTransferStartedMs = 0;
uint32_t gTransferLastRenderMs = 0;
uint16_t gTransferAccent = TFT_CYAN;
TaskHandle_t gTextTurnTaskHandle = nullptr;
portMUX_TYPE gTextTurnMux = portMUX_INITIALIZER_UNLOCKED;
TextTurnTaskResult* gCompletedTextTurn = nullptr;
TaskHandle_t gMainLoopTaskHandle = nullptr;
std::deque<String> gPendingTextTurns;
String gActiveTextTurn;
File gVoiceNotesScanDir;
bool gVoiceNotesScanActive = false;
uint16_t gVoiceNotesScanCount = 0;
bool gBootBackgroundActive = false;
uint8_t gBootBackgroundStep = 0;
String gBootBackgroundLabel;
bool gBootWifiStarted = false;
uint32_t gBootWifiStartMs = 0;
uint32_t gBootStepStartedMs = 0;
uint32_t gCaptivePortalLastAttemptMs = 0;
uint32_t gCaptivePortalLastOkMs = 0;
constexpr uint8_t kCMatrixCols = 30;
int8_t gCMatrixHead[kCMatrixCols] = {};
uint8_t gCMatrixSpeed[kCMatrixCols] = {};
uint32_t gCMatrixLastStepMs = 0;
uint16_t gCMatrixTick = 0;
bool gCMatrixInitialized = false;

void startHubWebSocket();
void pauseHubWebSocketForVoice();
void resumeHubWebSocketAfterVoice();
void render();
void setStatus(const String& text, uint32_t ttlMs);
void pushSystem(const String& text);
void pushError(const String& text);
bool readOtaApplyBootRequest();
void clearOtaApplyBootRequest();
void requestOtaApplyBootMode(const String& targetVersion);
bool remountSdStorage(const char* reason);
void beginTransferUi(const String& title, const String& detail, uint32_t total, uint16_t accent);
void updateTransferUi(uint32_t done, uint32_t total = 0, const String& detail = "");
void finishTransferUi(const String& statusText, bool ok);
std::vector<String> wrapText(const String& raw, int32_t pixelLimit);
String keyboardSignatureFromState();
bool ensureWifiForHttp(const char* reason, uint32_t timeoutMs = kHttpReconnectTimeoutMs);
bool ensureCaptivePortalAccess(bool force, const char* reason);
bool downloadUrlToFile(const String& url, const String& path, const String& expectedSha = "",
                       uint32_t expectedSize = 0, const String& progressTitle = "Downloading",
                       uint16_t progressAccent = TFT_CYAN, bool showProgress = true);
void prepareNetworkMemory(const char* reason, bool forceTtsBuffer = false);
bool releaseUiCanvasForNetwork(const char* reason);
void restoreUiCanvasAfterNetwork();
bool compactMemoryForUi(const char* reason, bool force = false);
void serviceMemoryGuard();
bool connectHubClient(WiFiClient& client, const char* reason, uint32_t readTimeoutSec = 45);
void synthesizeTcaKeyboardState();
void pollTcaKeyboardEvents();
void refreshKeyboardState();
void pollTyping();
bool hasHidKey(const Keyboard_Class::KeysState& keys, uint8_t keyCode);
void submitInput();
bool playVisibleVoiceHistoryLine();
bool downloadAndPlayResponseAudio(const String& url, const String& localPath, const String& sha256,
                                  uint32_t expectedSize, const String& title, const String& preview);
bool requestAndPlayTts(const String& text);
bool finishVoiceSubmission(bool transportOk, int statusCode, const String& response,
                           const String& pcmUploadPath, size_t dataSize);
bool fetchLatestInboxMessage(bool forcePlay = false, bool speak = true, bool quiet = false, bool assistantOnly = false);
bool injectInboxText(const String& text, bool speakAfter = true);
void schedulePostInstallStoryIfNeeded();
void servicePostInstallStory();
void saveHubEndpoint(const String& host, uint16_t port);
void saveDeviceToken(const String& token);
void startSetupPortal(const char* reason);
void serviceSetupPortal();
void renderSetupPortalUi();
void syncClockFromNtp(bool force = false);
void flashActivityLed(uint8_t r, uint8_t g, uint8_t b, uint32_t durationMs = 180);
void updateStatusLed();
void writeWavHeader(uint8_t* h, uint32_t dataSize, uint32_t sampleRate);
void handleRecordingStorageFailure();
void serviceRecordingToFile(bool refill = true);
void serviceRealtimeVoice();
void stopPlaybackStream();
void releaseRecordBuffer();
void releaseTtsBuffer();
void clearEmojiCache();
void toggleRealtimeVoice();
void startRealtimeSession(bool startAfterReady);
void startRealtimeRecording();
void stopRealtimeRecordingAndCommit();
void stopRealtimeRecordingForVad();
void closeRealtimeSession(const String& reason);
void resetRealtimePlaybackState(bool stopSpeaker = true);
void markRealtimeLatencyOrigin(const char* source);
void realtimeWsEvent(WStype_t type, uint8_t* payload, size_t length);
void handleHostSerialInput();
bool handleLocalCommand(const String& input);
void updateG0VoiceTrigger();
void servicePlaybackStream();
bool handleGlobalEscape();
AssistantPulseState assistantPulseState();
uint32_t uiSceneKey();
void serviceFocusLamp();
bool bindFocusLampPreset(bool breakPreset);
void serviceFocusCue();
void loadFocusSettings();
void saveFocusSettings();
void loadDeviceSettings();
void saveDeviceSettings();
void startDeferredBoot();
void serviceDeferredBoot();
bool bootBackgroundAllowsConnectivity();
void startVoiceNotesScan();
bool serviceVoiceNotesScan(uint32_t budgetMs = 6);
void loadAlarmSettings();
void saveAlarmSettings();
void loadPetState();
void savePetState(bool force = false);
void resetPet(bool fullReset);
void resetUncannyEyesRenderer();
void servicePet();
bool handlePetKey(char key, const Keyboard_Class::KeysState& keys);
bool applyPetCare(PetCareAction action);
void setUiMode(UiMode mode);
bool stopMeshMode(bool goHome = false);
bool handleMeshEscape();
void startMeshMode();
void serviceMeshMode();
bool meshBlocksMode(UiMode mode);
bool handleMeshKey(char key, const Keyboard_Class::KeysState& keys);
void renderMeshUi();
bool handleMeshHostCommand(const String& command);

bool focusStateRuns(FocusState state);
void focusStartOrResume();
void focusReset();
void updateFocusTimer();
void serviceFocusMetronome();
void focusTone(uint16_t freq, uint16_t durationMs);
void serviceAlarm();
bool handleAlarmKey(char key, const Keyboard_Class::KeysState& keys);
void renderAlarmUi();
void serviceSonar();
bool handleSonarKey(char key, const Keyboard_Class::KeysState& keys);
void renderSonarUi();
void initRfidLab(bool force = false);
void serviceRfidLab();
bool handleRfidLabKey(char key, const Keyboard_Class::KeysState& keys);
void renderRfidLabUi();
bool handleCalendarKey(char key, const Keyboard_Class::KeysState& keys);
void renderCalendarUi();
void serviceKeyRush();
bool handleKeyRushKey(char key, const Keyboard_Class::KeysState& keys);
void renderKeyRushUi();
void beginChessDemo();
void serviceChessDemo();
bool handleChessDemoKey(char key, const Keyboard_Class::KeysState& keys);
void renderChessDemoUi();
void beginCheckersDemo();
void serviceCheckersDemo();
bool handleCheckersDemoKey(char key, const Keyboard_Class::KeysState& keys);
void renderCheckersDemoUi();
void beginMinesweeper();
void serviceMinesweeper();
bool handleMinesweeperKey(char key, const Keyboard_Class::KeysState& keys);
void renderMinesweeperUi();
bool radioBusy();
bool vlcBusy();
bool deferVlcRemoteMode(UiMode mode);
void beginVlcRemote();
void serviceVlcRemote();
bool handleVlcRemoteKey(char key, const Keyboard_Class::KeysState& keys);
void renderVlcRemoteUi();
void stopInternetRadio();
bool deferInternetRadioMode(UiMode mode);
void beginInternetRadio();
void serviceInternetRadio();
bool handleInternetRadioKey(char key, const Keyboard_Class::KeysState& keys);
void renderInternetRadioUi();
void serviceBrainFlow();
void pauseBrainFlow();
bool handleBrainFlowKey(char key, const Keyboard_Class::KeysState& keys);
void brainFlowEscape();
bool routeBrainFlowEscape();
void renderBrainFlowUi();
void updateBatterySnapshot(bool force = false);
bool batteryExternalPowerPresent();
BatteryHistorySample batteryHistorySampleAt(uint8_t index);
void scanAudioAssets();
bool startPlaybackStreamFromWavFile(const String& path, const String& diag);
const char* clockFaceName(uint8_t face);
void loadAssetManifestSummary();
void loadOtaManifestSummary();
void scanNotes();
bool handleNotesKey(char key, const Keyboard_Class::KeysState& keys);
String currentConversationKey();
void togglePulseChatDisplay();
bool isEmojiAssetCodepoint(uint32_t codepoint);
bool decodeUtf8At(const String& value, int index, uint32_t& codepoint, int& consumed);
String normalizeEmojiDisplayText(const String& raw);
bool emojiAssetAvailable(uint32_t codepoint);
const EmojiCacheEntry* emojiCacheLookup(uint32_t codepoint);
String normalizeTopicTitleForDisplay(const String& raw, bool keepAvailableEmoji = true);
bool fetchRemoteAssetManifest();
bool fetchRemoteOtaManifest();
bool applyRemoteOtaManifestBody(const String& body);
bool homeFirmwareUpdateAvailable();
bool handleHomeUpdateKey(char key, const Keyboard_Class::KeysState& keys);
bool syncAssetsFromManifest(bool pomodoroOnly = false);
String fitCurrentFontToWidth(String text, int32_t pixelLimit);
void drawTinyFooter(uint16_t bg, uint16_t fg, const String& text, int16_t x = 12, int16_t y = 124,
                    int16_t w = 216);
String compactBytes(uint32_t bytes);
bool applyOtaFromManifest();
void beginOtaBootGuard();
bool confirmOtaBootIfPending(const char* reason);
void rollbackPendingOta(const char* reason);
void serviceOtaBootGuard();
bool uploadRuntimeLogs();
void processCompletedTextTurn();
void maybeStartNextTextTurn();
void textTurnTask(void* arg);
bool hubUsesTls();
String hubBaseUrl();
fs::FS* activeVoiceFs();
fs::FS* fallbackVoiceFs();
bool ensurePomodoroStorageOn(fs::FS& fs);
uint64_t activeStorageTotalBytes();
uint64_t activeStorageUsedBytes();
void configureEmojiRendering();
void scanEmojiAssets();
bool executeDeviceActions(JsonVariantConst actions);
bool executeDeviceActionsJson(const String& json);
bool executeDeviceAction(JsonObjectConst action);
bool executeOrDeferDeviceActionsJson(const String& json);
void serviceDeferredDeviceActions();
void servicePendingOtaAction();
bool startBackgroundManifestCheck(bool applyAfter, bool announce);
void applyDisplayBrightness();
void applySpeakerVolumeSetting();
bool handleScreensaverWake();
void markUserActivity();
void serviceIdleScreensaver();

void refreshFileManager();
bool handleFileManagerKey(char key, const Keyboard_Class::KeysState& keys);
void renderFileManagerUi();
